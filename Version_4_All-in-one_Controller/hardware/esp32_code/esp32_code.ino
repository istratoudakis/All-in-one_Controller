#include <SPI.h>
#include <TFT_eSPI.h> // Η νέα μας υπερ-βιβλιοθήκη
#include <Wire.h>              // Για την επικοινωνία I2C
#include <Adafruit_MCP23X17.h> // Η βιβλιοθήκη του IO Expander
#include <ESP32Encoder.h>      // ΝΕΑ ΒΙΒΛΙΟΘΗΚΗ: Για το Rotary Encoder!

TFT_eSPI tft = TFT_eSPI(); 
Adafruit_MCP23X17 mcp;         // Δημιουργία του αντικειμένου MCP
ESP32Encoder encoder;          // ΝΕΑ ΠΡΟΣΘΗΚΗ: Δημιουργία του αντικειμένου Encoder

// --- Colours ----
#define BLURPLE tft.color565(85, 104, 255)

// --- BUTTON PINS (Στο MCP23017) ---
const int clkPin = 25; // Rotary CLK
const int dtPin = 26;  // Rotary DT
const int swPin = 27;  // Rotary Button
const int BTN_MEDIA_TOGGLE = 0;
const int BTN_NEXT = 10; // GPA1 next
const int BTN_PREV = 11; // GPA2 previous
const int BTN_MIC_MUTE = 3; // GPA3 mute/unmute
const int BTN_CAMERA = 4; // GPA4 camera on/off
const int BTN_BOSS = 5; // GPA5 boss key

// ΠΡΟΣΘΗΚΗ: 3 Custom Links
const int BTN_LINK_1 = 2; // GPA6 custom link 1
const int BTN_LINK_2 = 13; // GPA7 custom link 2
const int BTN_LINK_3 = 1; // GPB0 custom link 3

// ΝΕΟ ΚΟΥΜΠΙ: Discord Deafen
const int BTN_DISCORD_DEAFEN = 6; // GPB1 για το Deafen

// ΝΕΑ ΚΟΥΜΠΙΑ: OBS Studio
const int BTN_OBS_BRB = 8;     // GPB2 για σκηνή BRB
const int BTN_OBS_SCREEN = 9;  // GPB3 για σκηνή Screen
const int BTN_OBS_REC = 7;  // GPB4 για Record (Start/Stop)

// ΝΕΟ ΚΟΥΜΠΙ: AI Voice Control (Push-to-Talk)
const int BTN_VOICE_AI = 12;    // GPB5

// ΝΕΟ ΚΟΥΜΠΙ: Zoom Raise Hand
const int BTN_ZOOM_HAND = 14;   // GPB6

bool lastNextState = HIGH;
bool lastPrevState = HIGH;
bool lastMediaToggleState = HIGH;
bool lastMicMuteState = HIGH;
bool lastCameraState = HIGH;
bool lastBossState = HIGH;

// ΠΡΟΣΘΗΚΗ: States για τα Custom Links
bool lastLink1State = HIGH;
bool lastLink2State = HIGH;
bool lastLink3State = HIGH;

// ΝΕΟ STATE: Discord Deafen
bool lastDiscordDeafenState = HIGH;

// ΝΕΑ STATES: OBS Studio
bool lastObsBrbState = HIGH;
bool lastObsScreenState = HIGH;
bool lastObsRecordState = HIGH;

//Gemini
bool lastVoiceAiState = HIGH;

// ΝΕΟ ΚΟΥΜΠΙ: Zoom Raise Hand
bool lastZoomHandState = HIGH;

unsigned long lastButtonPress = 0;

// --- GLOBAL VARIABLES ---
int currentScreen = 0; 
bool connection_status = false;

String currentSong = "";
int scrollIndex = 0;
unsigned long lastScrollTime = 0; 

// ==========================================
// IMAGE ARRAYS (32x32)
// ==========================================
const unsigned char spotify_logo [] PROGMEM = {
  0x00, 0x00, 0x00, 0x00, 0x00, 0x07, 0xe0, 0x00, 0x00, 0x3f, 0xfc, 0x00, 0x00, 0xff, 0xff, 0x00,
  0x01, 0xff, 0xff, 0x80, 0x03, 0xff, 0xff, 0xc0, 0x07, 0xff, 0xff, 0xe0, 0x0f, 0xff, 0xff, 0xf0,
  0x1f, 0xc0, 0x03, 0xf8, 0x1f, 0x00, 0x00, 0xf8, 0x3e, 0x0f, 0xf0, 0x7c, 0x3c, 0x7f, 0xfe, 0x3c,
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  0x0f, 0xff, 0xff, 0xf0, 0x07, 0xff, 0xff, 0xe0, 0x03, 0xff, 0xff, 0xc0, 0x00, 0xff, 0xff, 0x00
};

const unsigned char volume_logo [] PROGMEM = {
  0x00, 0x00, 0x00, 0x00, 0x00, 0x00, 0x00, 0x00, 0x00, 0x01, 0x80, 0x00, 0x00, 0x03, 0x80, 0x00, 
  0x00, 0x07, 0x86, 0x30, 0x00, 0x0f, 0x86, 0x30, 0x00, 0x1f, 0x86, 0x30, 0x00, 0x3f, 0x86, 0x30, 
  0x07, 0xff, 0x86, 0x30, 0x07, 0xff, 0x86, 0x30, 0x07, 0xff, 0x86, 0x30, 0x07, 0xff, 0x86, 0x30, 
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  0x00, 0x00, 0x00, 0x00, 0x00, 0x00, 0x00, 0x00, 0x00, 0x00, 0x00, 0x00, 0x00, 0x00, 0x00, 0x00
};

const unsigned char microphone_muted [] PROGMEM = {
  0xff, 0xff, 0xff, 0xff, 0xff, 0xff, 0xff, 0xff, 0xff, 0xff, 0xff, 0xfb, 0xff, 0xfc, 0x3f, 0xe3, 
  0xff, 0xf8, 0x1f, 0xe7, 0xff, 0xf0, 0x0f, 0xcf, 0xff, 0xe0, 0x1f, 0x1f, 0xff, 0xe0, 0x3e, 0x3f, 
  0xff, 0xe0, 0x7e, 0x7f, 0xff, 0xe0, 0xfc, 0xff, 0xff, 0xe0, 0xf1, 0xff, 0xff, 0xe3, 0xe3, 0xff, 
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  0xc7, 0xe0, 0x0f, 0xff, 0xcf, 0xff, 0xff, 0xff, 0xff, 0xff, 0xff, 0xff, 0xff, 0xff, 0xff, 0xff
};

const unsigned char microphone_unmuted [] PROGMEM = {
  0xff, 0xff, 0xff, 0xff, 0xff, 0xfc, 0x3f, 0xff, 0xff, 0xf0, 0x0f, 0xff, 0xff, 0xf0, 0x0f, 0xff, 
  0xff, 0xe0, 0x07, 0xff, 0xff, 0xe0, 0x07, 0xff, 0xff, 0xe0, 0x07, 0xff, 0xff, 0xe0, 0x07, 0xff, 
  0xff, 0xe0, 0x07, 0xff, 0xff, 0xe0, 0x07, 0xff, 0xff, 0xe0, 0x07, 0xff, 0xff, 0xe0, 0x07, 0xff, 
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  0xff, 0xfe, 0x7f, 0xff, 0xff, 0x80, 0x01, 0xff, 0xff, 0x80, 0x01, 0xff, 0xff, 0xff, 0xff, 0xff
};

const unsigned char cam_logo [] PROGMEM = {
  0x00, 0x00, 0x00, 0x00, 0x00, 0x00, 0x00, 0x00, 0x00, 0x0f, 0xf0, 0x00, 0x00, 0x1f, 0xf8, 0x00,
  0x00, 0x3f, 0xfc, 0x00, 0x0f, 0xff, 0xff, 0xf0, 0x1f, 0xff, 0xff, 0xf8, 0x3f, 0xff, 0xff, 0xfc,
  0x3f, 0xff, 0xff, 0xfc, 0x3f, 0xf8, 0x1f, 0xfc, 0x3f, 0xf0, 0x0f, 0xfc, 0x3f, 0xe0, 0x07, 0xfc,
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  0x00, 0x00, 0x00, 0x00, 0x00, 0x00, 0x00, 0x00, 0x00, 0x00, 0x00, 0x00, 0x00, 0x00, 0x00, 0x00
};

const unsigned char discord_logo [] PROGMEM = {
  0x00, 0x00, 0x00, 0x00, 0x00, 0x00, 0x00, 0x00, 0x00, 0x00, 0x00, 0x00, 0x00, 0x00, 0x00, 0x00, 
  0x00, 0x00, 0x00, 0x00, 0x00, 0x00, 0x00, 0x00, 0x00, 0x00, 0x00, 0x00, 0x00, 0x00, 0x00, 0x00, 
  0x00, 0x00, 0x00, 0x00, 0x00, 0x00, 0x00, 0x00, 0x00, 0x00, 0x00, 0x00, 0x00, 0x00, 0x00, 0x00, 
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  0x00, 0x00, 0x00, 0x00, 0x00, 0x00, 0x00, 0x00, 0x00, 0x00, 0x00, 0x00, 0x00, 0x00, 0x00, 0x00
};

const unsigned char undeafened [] PROGMEM = {
  0xff, 0xff, 0xff, 0xff, 0xff, 0xff, 0xff, 0xff, 0xff, 0xff, 0xff, 0xff, 0xff, 0xe0, 0x07, 0xff, 
  0xff, 0x80, 0x01, 0xff, 0xff, 0x01, 0x80, 0xff, 0xfe, 0x1f, 0xf8, 0x7f, 0xfc, 0x3f, 0xfc, 0x3f, 
  0xf8, 0x7f, 0xfe, 0x1f, 0xf0, 0xff, 0xff, 0x0f, 0xf1, 0xff, 0xff, 0x8f, 0xe3, 0xff, 0xff, 0xc7, 
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  0xe0, 0x3f, 0xfc, 0x07, 0xff, 0xff, 0xff, 0xff, 0xff, 0xff, 0xff, 0xff, 0xff, 0xff, 0xff, 0xff
};

const unsigned char deafened [] PROGMEM = {
  0xff, 0xff, 0xff, 0xff, 0xff, 0xf8, 0x07, 0xff, 0xff, 0xe0, 0x01, 0xff, 0xff, 0x80, 0xe0, 0x7f, 
  0xff, 0x87, 0xfc, 0x3f, 0xef, 0x9f, 0xfe, 0x1f, 0xc7, 0xff, 0xff, 0x0f, 0xe3, 0xff, 0xff, 0x8f, 
  0xf1, 0xff, 0xff, 0xc7, 0xf8, 0xff, 0xff, 0xc7, 0xf8, 0x7f, 0xff, 0xe7, 0xf8, 0x3f, 0xff, 0xe3, 
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  0xff, 0xff, 0xff, 0x1f, 0xff, 0xff, 0xff, 0xcf, 0xff, 0xff, 0xff, 0xdf, 0xff, 0xff, 0xff, 0xff
};

// ==========================================
// SCREEN DRAWING FUNCTIONS
// ==========================================

void drawBootScreen() {
  tft.fillScreen(TFT_BLACK); 
  
  if (connection_status == false) {
    tft.setTextColor(TFT_RED); 
    tft.setTextSize(3);             
    tft.setCursor(90, 60);         
    tft.print("Connection Status");

    tft.fillRect(100, 120, 280, 80, TFT_RED);
    tft.setTextColor(TFT_BLACK); 
    tft.setTextSize(3);              
    tft.setCursor(110, 145);          
    tft.print("NOT ESTABLISHED");
  } else {
    tft.setTextColor(TFT_GREEN); 
    tft.setTextSize(3);             
    tft.setCursor(80, 60);         
    tft.print("Connection Status");

    tft.fillRect(100, 120, 280, 80, TFT_GREEN);
    tft.setTextColor(TFT_WHITE); 
    tft.setTextSize(3);              
    tft.setCursor(140, 145);          
    tft.print("ESTABLISHED");
    delay(1000);
    drawMainScreen();
  }
}

void drawMainScreen() {
  tft.fillScreen(TFT_BLACK); 

  // --- ΑΡΙΣΤΕΡΟ ΚΟΥΤΙ: PC SYSTEM (Λευκό) ---
  tft.drawRect(0, 0, 238, 320, TFT_WHITE); 
  tft.fillRect(2, 2, 234, 316, TFT_WHITE);

  // Volume UI
  tft.drawBitmap(20, 20, volume_logo, 32, 32, TFT_BLACK);
  tft.drawRect(70, 31, 140, 10, TFT_BLACK); 

  // Mic UI (Defaults to UNMUTED)
  tft.drawBitmap(25, 120, microphone_unmuted, 32, 32, TFT_BLACK);
  tft.fillRect(20, 160, 50, 30, TFT_WHITE); 
  tft.setTextSize(3);
  tft.setTextColor(TFT_GREEN); 
  tft.setCursor(22, 165);
  tft.print("ON");

  // Cam UI
  tft.drawBitmap(145, 120, cam_logo, 32, 32, TFT_BLACK);
  tft.fillRect(140, 160, 60, 30, TFT_WHITE);
  tft.setTextColor(TFT_RED);
  tft.setCursor(140, 165);
  tft.print("OFF");

  // --- ΔΕΞΙ ΚΟΥΤΙ ΠΑΝΩ: MULTIMEDIA (Μαύρο) ---
  tft.drawRect(238, 0, 242, 160, TFT_WHITE); 
  tft.fillRect(240, 2, 238, 156, TFT_BLACK);

  // Spotify UI
  tft.drawBitmap(250, 20, spotify_logo, 32, 32, TFT_GREEN);
  tft.drawRect(250, 110, 210, 10, TFT_WHITE);

  // Spotify Timestamps
  tft.setTextSize(2);
  tft.setTextColor(TFT_WHITE);
  tft.setCursor(250, 130);
  tft.print("0:00");
  tft.setCursor(410, 130);
  tft.print("0:00");

  // --- ΔΕΞΙ ΚΟΥΤΙ ΚΑΤΩ: DISCORD AREA (Blurple) ---
  tft.drawRect(238, 160, 242, 160, TFT_WHITE); 
  tft.fillRect(240, 162, 238, 156, BLURPLE);

  // Main Discord Identity Logo 
  tft.drawBitmap(260, 205, discord_logo, 64, 64, TFT_WHITE);

  // Status Logo (Undeafened by default)
  tft.drawBitmap(380, 220, undeafened, 32, 32, TFT_WHITE); 
}

// ==========================================
// SETUP
// ==========================================
void setup() {
  Serial.begin(115200);
  delay(1000); 
  Serial.println("--- STARTING BOOT ---");

  // --- ΑΡΧΙΚΟΠΟΙΗΣΗ ΤΟΥ IO EXPANDER ---
  if (!mcp.begin_I2C()) {
    Serial.println("❌ ΣΦΑΛΜΑ: Το MCP23017 δεν βρέθηκε! (I2C Error)");
  } else {
    Serial.println("✅ MCP23017 Initialized!");
    mcp.pinMode(BTN_MEDIA_TOGGLE, INPUT_PULLUP);
    mcp.pinMode(BTN_NEXT, INPUT_PULLUP);
    mcp.pinMode(BTN_PREV, INPUT_PULLUP);
    mcp.pinMode(BTN_MIC_MUTE, INPUT_PULLUP);
    mcp.pinMode(BTN_CAMERA, INPUT_PULLUP);
    mcp.pinMode(BTN_BOSS, INPUT_PULLUP);
    
    // ΠΡΟΣΘΗΚΗ: Setup για τα Custom Buttons
    mcp.pinMode(BTN_LINK_1, INPUT_PULLUP);
    mcp.pinMode(BTN_LINK_2, INPUT_PULLUP);
    mcp.pinMode(BTN_LINK_3, INPUT_PULLUP);

    // ΝΕΟ: Setup για το Discord Deafen
    mcp.pinMode(BTN_DISCORD_DEAFEN, INPUT_PULLUP);

    // ΝΕΟ: Setup για τα OBS Buttons
    mcp.pinMode(BTN_OBS_BRB, INPUT_PULLUP);
    mcp.pinMode(BTN_OBS_SCREEN, INPUT_PULLUP);
    mcp.pinMode(BTN_OBS_REC, INPUT_PULLUP);

    // ΝΕΟ: Setup για το AI Voice Button
    mcp.pinMode(BTN_VOICE_AI, INPUT_PULLUP);

    // ΝΕΟ: Setup για το Zoom Raise Hand
    mcp.pinMode(BTN_ZOOM_HAND, INPUT_PULLUP);
  }

  // --- ΝΕΑ ΑΡΧΙΚΟΠΟΙΗΣΗ ROTARY ENCODER ---
  ESP32Encoder::useInternalWeakPullResistors = puType::up; // Ενεργοποιεί τις εσωτερικές αντιστάσεις
  encoder.attachHalfQuad(dtPin, clkPin);           // Συνδέει τα pins στο hardware
  encoder.clearCount();                            // Μηδενίζει τον μετρητή

  pinMode(swPin, INPUT_PULLUP); // Το κουμπί (πάτημα) του rotary μένει ως έχει

  tft.begin();
  tft.setRotation(1); 
  
  tft.fillScreen(TFT_WHITE); 
  delay(200);
  tft.fillScreen(TFT_BLACK); 
  delay(200);
  
  Serial.println("Display Initialized");
  drawBootScreen();
}

// ==========================================
// MAIN LOOP
// ==========================================
void loop() {

 // --- ΔΙΑΒΑΣΜΑ ΚΟΥΜΠΙΩΝ ΑΠΟ ΤΟ MCP23017 ---
  bool currentMediaToggleState = mcp.digitalRead(BTN_MEDIA_TOGGLE);
      
  // 1. Έλεγχος Περιστροφής (Volume) - ΝΕΟΣ, ΑΣΦΑΛΗΣ ΤΡΟΠΟΣ
  long currentEncoderCount = encoder.getCount(); // Παίρνουμε την τιμή που υπολογίστηκε στο παρασκήνιο
  
  if (currentEncoderCount != 0) {
    if (currentEncoderCount > 0) {
      Serial.println("<VOL:UP>"); // Αν κατά λάθος το UP κάνει DOWN, απλά άλλαξέ τα μεταξύ τους εδώ!
    } else {
      Serial.println("<VOL:DOWN>");
    }
    encoder.clearCount(); // Μηδενίζουμε για να είναι έτοιμο για το επόμενο "κλικ"
  }

  // 2. Έλεγχος Πατήματος (Pause/Play)
  if (digitalRead(swPin) == LOW) {
    if (millis() - lastButtonPress > 300) { // Debounce 300ms
      Serial.println("<BTN:MEDIA_TOGGLE>");
      lastButtonPress = millis();
    }
  }

  // --- ΔΙΑΒΑΣΜΑ ΚΟΥΜΠΙΟΥ: NEXT ---
  bool currentNextState = mcp.digitalRead(BTN_NEXT);
  if (lastNextState == HIGH && currentNextState == LOW) {
    Serial.println("<BTN:NEXT>"); 
    delay(50); // Debounce
  }
  lastNextState = currentNextState;

  // --- ΔΙΑΒΑΣΜΑ ΚΟΥΜΠΙΟΥ: PREVIOUS ---
  bool currentPrevState = mcp.digitalRead(BTN_PREV);
  if (lastPrevState == HIGH && currentPrevState == LOW) {
    Serial.println("<BTN:PREV>"); 
    delay(50); // Debounce
  }
  lastPrevState = currentPrevState;

  // --- ΔΙΑΒΑΣΜΑ ΚΟΥΜΠΙΟΥ: MUTE ----
  bool currentMicMuteState = mcp.digitalRead(BTN_MIC_MUTE);
  if (lastMicMuteState == HIGH && currentMicMuteState == LOW) {
      Serial.println("<BTN:MIC_MUTE>"); 
      delay(50); // Debounce
  }
  lastMicMuteState = currentMicMuteState;

  // --- ΔΙΑΒΑΣΜΑ ΚΟΥΜΠΙΟΥ: CAMERA ---
  bool currentCameraState = mcp.digitalRead(BTN_CAMERA);
  if (lastCameraState == HIGH && currentCameraState == LOW) {
      Serial.println("<BTN:CAMERA>"); 
      delay(50); // Debounce
  }
  lastCameraState = currentCameraState;

  // --- ΔΙΑΒΑΣΜΑ ΚΟΥΜΠΙΟΥ: BOSS KEY ---
  bool currentBossState = mcp.digitalRead(BTN_BOSS);
  if (lastBossState == HIGH && currentBossState == LOW) {
      Serial.println("<BTN:BOSS_KEY>"); 
      delay(50); // Debounce
  }
  lastBossState = currentBossState;

  // ΠΡΟΣΘΗΚΗ: ΔΙΑΒΑΣΜΑ ΚΟΥΜΠΙΟΥ: CUSTOM LINK 1
  bool currentLink1State = mcp.digitalRead(BTN_LINK_1);
  if (lastLink1State == HIGH && currentLink1State == LOW) {
      Serial.println("LINK_1"); 
      delay(50); 
  }
  lastLink1State = currentLink1State;

  // ΠΡΟΣΘΗΚΗ: ΔΙΑΒΑΣΜΑ ΚΟΥΜΠΙΟΥ: CUSTOM LINK 2
  bool currentLink2State = mcp.digitalRead(BTN_LINK_2);
  if (lastLink2State == HIGH && currentLink2State == LOW) {
      Serial.println("LINK_2"); 
      delay(50); 
  }
  lastLink2State = currentLink2State;

  // ΠΡΟΣΘΗΚΗ: ΔΙΑΒΑΣΜΑ ΚΟΥΜΠΙΟΥ: CUSTOM LINK 3
  bool currentLink3State = mcp.digitalRead(BTN_LINK_3);
  if (lastLink3State == HIGH && currentLink3State == LOW) {
      Serial.println("LINK_3"); 
      delay(50); 
  }
  lastLink3State = currentLink3State;

  // ΝΕΟ: ΔΙΑΒΑΣΜΑ ΚΟΥΜΠΙΟΥ: DISCORD DEAFEN
  bool currentDiscordDeafenState = mcp.digitalRead(BTN_DISCORD_DEAFEN);
  if (lastDiscordDeafenState == HIGH && currentDiscordDeafenState == LOW) {
      // Στέλνει ακριβώς τη λέξη που περιμένει η Python στο handle_discord_shortcuts
      Serial.println("DISCORD_DEAFEN"); 
      delay(50); // Debounce
  }
  lastDiscordDeafenState = currentDiscordDeafenState;

   // --- ΔΙΑΒΑΣΜΑ ΚΟΥΜΠΙΟΥ: OBS BRB ---
  bool currentObsBrbState = mcp.digitalRead(BTN_OBS_BRB);
  if (lastObsBrbState == HIGH && currentObsBrbState == LOW) {
      Serial.println("OBS_BRB"); 
      delay(50); // Debounce
  }
  lastObsBrbState = currentObsBrbState;

  // --- ΔΙΑΒΑΣΜΑ ΚΟΥΜΠΙΟΥ: OBS SCREEN ---
  bool currentObsScreenState = mcp.digitalRead(BTN_OBS_SCREEN);
  if (lastObsScreenState == HIGH && currentObsScreenState == LOW) {
      Serial.println("OBS_SCREEN"); 
      delay(50); // Debounce
  }
  lastObsScreenState = currentObsScreenState;

  // --- ΔΙΑΒΑΣΜΑ ΚΟΥΜΠΙΟΥ: OBS RECORD ---
  bool currentObsRecordState = mcp.digitalRead(BTN_OBS_REC);
  if (lastObsRecordState == HIGH && currentObsRecordState == LOW) {
      Serial.println("OBS_REC"); 
      delay(50); // Debounce
  }
  lastObsRecordState = currentObsRecordState;
  
  // --- ΔΙΑΒΑΣΜΑ ΚΟΥΜΠΙΟΥ: AI VOICE (PUSH-TO-TALK) ---
  bool currentVoiceAiState = mcp.digitalRead(BTN_VOICE_AI);
  
  // Έλεγχος: Αν το κουμπί μόλις πατήθηκε (Κρατημένο)
  if (lastVoiceAiState == HIGH && currentVoiceAiState == LOW) {
      Serial.println("<VOICE:START>"); 
      delay(50); // Debounce
  } 
  // Έλεγχος: Αν το κουμπί μόλις αφέθηκε (Ελεύθερο)
  else if (lastVoiceAiState == LOW && currentVoiceAiState == HIGH) {
      Serial.println("<VOICE:STOP>"); 
      delay(50); // Debounce
  }
  lastVoiceAiState = currentVoiceAiState;

  // --- ΔΙΑΒΑΣΜΑ ΚΟΥΜΠΙΟΥ: ZOOM RAISE HAND ---
  bool currentZoomHandState = mcp.digitalRead(BTN_ZOOM_HAND);
  
  if (lastZoomHandState == HIGH && currentZoomHandState == LOW) {
      Serial.println("ZOOM_HAND"); 
      delay(50); // Debounce
  }
  lastZoomHandState = currentZoomHandState;


  // --- TEXT ANIMATION (MARQUEE) ---
  if (connection_status == true && currentSong.length() > 11) {
    
    int waitTime = 300; 
    if (scrollIndex == 0) {
      waitTime = 1500; 
    }

    if (millis() - lastScrollTime > waitTime) {
      lastScrollTime = millis(); 
      
      tft.fillRect(250, 70, 210, 30, TFT_BLACK); 
      
      String visibleText = currentSong.substring(scrollIndex, scrollIndex + 11);
      
      tft.setTextSize(3);
      tft.setTextColor(TFT_WHITE);
      tft.setCursor(250, 70);
      tft.print(visibleText);

      scrollIndex++;
      
      if (scrollIndex > currentSong.length() - 11) {
        scrollIndex = 0; 
      }
    }
  }
  
  // --- SERIAL COMMUNICATION ---
  if (Serial.available() > 0) {
    
    String incomingMessage = Serial.readStringUntil('\n');
    incomingMessage.trim();
    
    // Unlock Screen
    if (connection_status == false) {
      if (incomingMessage == "<PC_OK>") {
        connection_status = true;      
        drawBootScreen();         
      }
    }
    
    delay(50); 

    // Spotify Progress Bar % Listener
    if (incomingMessage.startsWith("<SPOT_PERC:")) {
        String valueText = incomingMessage.substring(11, incomingMessage.indexOf('>'));
        int progress = valueText.toInt(); 
        int barWidth = map(progress, 0, 100, 0, 206); 

        tft.fillRect(252, 112, barWidth, 6, TFT_WHITE); 
        tft.fillRect(252 + barWidth, 112, 206 - barWidth, 6, TFT_BLACK); 
    }
    
    // Spotify Song Name Listener
    else if (incomingMessage.startsWith("<SPOT_INFO:")) {
      String newSong = incomingMessage.substring(11, incomingMessage.indexOf('>'));
      
      if (newSong.length() > 11) {
        newSong += "   ";
      }

      if (currentSong != newSong) {
        currentSong = newSong;
        scrollIndex = 0; 

        tft.fillRect(250, 70, 210, 30, TFT_BLACK); 
        tft.setTextSize(3);
        tft.setTextColor(TFT_WHITE);
        tft.setCursor(250, 70);

        if (currentSong.length() <= 11) {
          tft.print(currentSong); 
        }
      }
    }

    // Current Time Listener
    else if (incomingMessage.startsWith("<SPOT_POS:")) {
      String curTime = incomingMessage.substring(10, incomingMessage.indexOf('>'));
      
      tft.fillRect(250, 130, 60, 20, TFT_BLACK); 
      tft.setTextSize(2);
      tft.setTextColor(TFT_WHITE);
      tft.setCursor(250, 130);
      tft.print(curTime);
    }

    // Total Time Listener
    else if (incomingMessage.startsWith("<SPOT_DUR:")) {
      String maxTime = incomingMessage.substring(10, incomingMessage.indexOf('>'));
      
      tft.fillRect(410, 130, 60, 20, TFT_BLACK); 
      tft.setTextSize(2);
      tft.setTextColor(TFT_WHITE);
      tft.setCursor(410, 130); 
      tft.print(maxTime);
    }
    
    // PC Volume Listener
    else if (incomingMessage.startsWith("<VOL:")) {
        String valueText = incomingMessage.substring(5, incomingMessage.indexOf('>'));
        int volume = valueText.toInt(); 
        int barWidth = map(volume, 0, 100, 0, 136);

        tft.fillRect(72, 33, barWidth, 6, TFT_BLACK); 
        tft.fillRect(72 + barWidth, 33, 136 - barWidth, 6, TFT_WHITE); 
    } 
    
    // Mic Status Listener
    else if (incomingMessage.startsWith("<MIC:")) {
      String status = incomingMessage.substring(5, incomingMessage.indexOf('>'));
      
      tft.fillRect(20, 160, 60, 30, TFT_WHITE); 
      tft.fillRect(25, 120, 32, 32, TFT_WHITE); 

      tft.setTextSize(3);
      tft.setCursor(22, 165);

      if (status == "ON") {
        tft.drawBitmap(25, 120, microphone_unmuted, 32, 32, TFT_BLACK);
        tft.setTextColor(TFT_GREEN);
        tft.print("ON");
      } else {
        tft.drawBitmap(25, 120, microphone_muted, 32, 32, TFT_RED);
        tft.setTextColor(TFT_RED);
        tft.print("OFF");
      }
    }

    // Cam Status Listener
    else if (incomingMessage.startsWith("<CAM:")) {
      String status = incomingMessage.substring(5, incomingMessage.indexOf('>'));
      
      tft.fillRect(140, 160, 60, 30, TFT_WHITE); 
      tft.setTextSize(3);
      tft.setCursor(140, 165);

      if (status == "ON") {
        tft.setTextColor(TFT_GREEN);
        tft.print("ON");
      } else {
        tft.setTextColor(TFT_RED);
        tft.print("OFF");
      }
    }
    
    // Discord Status Listener
    else if (incomingMessage.startsWith("<DISC:")) {
      String status = incomingMessage.substring(6, incomingMessage.indexOf('>'));
      
      tft.fillRect(380, 220, 32, 32, BLURPLE); 

      if (status == "DEAF") {
        tft.drawBitmap(380, 220, deafened, 32, 32, TFT_RED);
      } else {
        tft.drawBitmap(380, 220, undeafened, 32, 32, TFT_WHITE);
      }
    }
  }
}