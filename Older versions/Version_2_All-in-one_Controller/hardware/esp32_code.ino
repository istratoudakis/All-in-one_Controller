#include <SPI.h>
#include <TFT_eSPI.h> // Η νέα μας υπερ-βιβλιοθήκη
#include <Wire.h>              // ΠΡΟΣΘΗΚΗ: Για την επικοινωνία I2C
#include <Adafruit_MCP23X17.h> // ΠΡΟΣΘΗΚΗ: Η βιβλιοθήκη του IO Expander

TFT_eSPI tft = TFT_eSPI(); 
Adafruit_MCP23X17 mcp;         // ΠΡΟΣΘΗΚΗ: Δημιουργία του αντικειμένου MCP

// --- Colours ----
#define BLURPLE tft.color565(85, 104, 255)

// --- ΠΡΟΣΘΗΚΗ: BUTTON PINS (Στο MCP23017) ---
const int BTN_SPOT_TOGGLE = 0; // GPA0 Pause
// --- ΝΕΑ BUTTON PINS ΣΤΟ MCP23017 ---
const int BTN_NEXT = 1; // GPA1 next
const int BTN_PREV = 2; // GPA2 previous

bool lastNextState = HIGH;
bool lastPrevState = HIGH;
bool lastSpotToggleState = HIGH;

// --- GLOBAL VARIABLES ---
int currentScreen = 0; 
bool connection_status = false;

String currentSong = "";
int scrollIndex = 0;
unsigned long lastScrollTime = 0; 

// ==========================================
// IMAGE ARRAYS (32x32)
// ==========================================
// (Τα arrays παραμένουν ακριβώς όπως τα είχες)
const unsigned char spotify_logo [] PROGMEM = {
  0x00, 0x00, 0x00, 0x00, 0x00, 0x07, 0xe0, 0x00, 0x00, 0x3f, 0xfc, 0x00, 0x00, 0xff, 0xff, 0x00,
  0x01, 0xff, 0xff, 0x80, 0x03, 0xff, 0xff, 0xc0, 0x07, 0xff, 0xff, 0xe0, 0x0f, 0xff, 0xff, 0xf0,
  0x1f, 0xc0, 0x03, 0xf8, 0x1f, 0x00, 0x00, 0xf8, 0x3e, 0x0f, 0xf0, 0x7c, 0x3c, 0x7f, 0xfe, 0x3c,
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  0x0f, 0xff, 0xff, 0xf0, 0x07, 0xff, 0xff, 0xe0, 0x03, 0xff, 0xff, 0xc0, 0x00, 0xff, 0xff, 0x00
};

const unsigned char volume_logo [] PROGMEM = {
  0x00, 0x00, 0x00, 0x00, 0x00, 0x00, 0x00, 0x00, 0x00, 0x01, 0x80, 0x00, 0x00, 0x03, 0x80, 0x00, 
  0x00, 0x07, 0x86, 0x30, 0x00, 0x0f, 0x86, 0x30, 0x00, 0x1f, 0x86, 0x30, 0x00, 0x3f, 0x86, 0x30, 
  0x07, 0xff, 0x86, 0x30, 0x07, 0xff, 0x86, 0x30, 0x07, 0xff, 0x86, 0x30, 0x07, 0xff, 0x86, 0x30, 
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  0x00, 0x00, 0x00, 0x00, 0x00, 0x00, 0x00, 0x00, 0x00, 0x00, 0x00, 0x00, 0x00, 0x00, 0x00, 0x00
};

const unsigned char microphone_muted [] PROGMEM = {
  0xff, 0xff, 0xff, 0xff, 0xff, 0xff, 0xff, 0xff, 0xff, 0xff, 0xff, 0xfb, 0xff, 0xfc, 0x3f, 0xe3, 
  0xff, 0xf8, 0x1f, 0xe7, 0xff, 0xf0, 0x0f, 0xcf, 0xff, 0xe0, 0x1f, 0x1f, 0xff, 0xe0, 0x3e, 0x3f, 
  0xff, 0xe0, 0x7e, 0x7f, 0xff, 0xe0, 0xfc, 0xff, 0xff, 0xe0, 0xf1, 0xff, 0xff, 0xe3, 0xe3, 0xff, 
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  0xc7, 0xe0, 0x0f, 0xff, 0xcf, 0xff, 0xff, 0xff, 0xff, 0xff, 0xff, 0xff, 0xff, 0xff, 0xff, 0xff
};

const unsigned char microphone_unmuted [] PROGMEM = {
  0xff, 0xff, 0xff, 0xff, 0xff, 0xfc, 0x3f, 0xff, 0xff, 0xf0, 0x0f, 0xff, 0xff, 0xf0, 0x0f, 0xff, 
  0xff, 0xe0, 0x07, 0xff, 0xff, 0xe0, 0x07, 0xff, 0xff, 0xe0, 0x07, 0xff, 0xff, 0xe0, 0x07, 0xff, 
  0xff, 0xe0, 0x07, 0xff, 0xff, 0xe0, 0x07, 0xff, 0xff, 0xe0, 0x07, 0xff, 0xff, 0xe0, 0x07, 0xff, 
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  0xff, 0xfe, 0x7f, 0xff, 0xff, 0x80, 0x01, 0xff, 0xff, 0x80, 0x01, 0xff, 0xff, 0xff, 0xff, 0xff
};

const unsigned char cam_logo [] PROGMEM = {
  0x00, 0x00, 0x00, 0x00, 0x00, 0x00, 0x00, 0x00, 0x00, 0x0f, 0xf0, 0x00, 0x00, 0x1f, 0xf8, 0x00,
  0x00, 0x3f, 0xfc, 0x00, 0x0f, 0xff, 0xff, 0xf0, 0x1f, 0xff, 0xff, 0xf8, 0x3f, 0xff, 0xff, 0xfc,
  0x3f, 0xff, 0xff, 0xfc, 0x3f, 0xf8, 0x1f, 0xfc, 0x3f, 0xf0, 0x0f, 0xfc, 0x3f, 0xe0, 0x07, 0xfc,
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  0x00, 0x00, 0x00, 0x00, 0x00, 0x00, 0x00, 0x00, 0x00, 0x00, 0x00, 0x00, 0x00, 0x00, 0x00, 0x00
};

const unsigned char discord_logo [] PROGMEM = {
  0x00, 0x00, 0x00, 0x00, 0x00, 0x00, 0x00, 0x00, 0x00, 0x00, 0x00, 0x00, 0x00, 0x00, 0x00, 0x00, 
  0x00, 0x00, 0x00, 0x00, 0x00, 0x00, 0x00, 0x00, 0x00, 0x00, 0x00, 0x00, 0x00, 0x00, 0x00, 0x00, 
  0x00, 0x00, 0x00, 0x00, 0x00, 0x00, 0x00, 0x00, 0x00, 0x00, 0x00, 0x00, 0x00, 0x00, 0x00, 0x00, 
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  0x00, 0x00, 0x00, 0x00, 0x00, 0x00, 0x00, 0x00, 0x00, 0x00, 0x00, 0x00, 0x00, 0x00, 0x00, 0x00
};

const unsigned char undeafened [] PROGMEM = {
  0xff, 0xff, 0xff, 0xff, 0xff, 0xff, 0xff, 0xff, 0xff, 0xff, 0xff, 0xff, 0xff, 0xe0, 0x07, 0xff, 
  0xff, 0x80, 0x01, 0xff, 0xff, 0x01, 0x80, 0xff, 0xfe, 0x1f, 0xf8, 0x7f, 0xfc, 0x3f, 0xfc, 0x3f, 
  0xf8, 0x7f, 0xfe, 0x1f, 0xf0, 0xff, 0xff, 0x0f, 0xf1, 0xff, 0xff, 0x8f, 0xe3, 0xff, 0xff, 0xc7, 
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  0xe0, 0x3f, 0xfc, 0x07, 0xff, 0xff, 0xff, 0xff, 0xff, 0xff, 0xff, 0xff, 0xff, 0xff, 0xff, 0xff
};

const unsigned char deafened [] PROGMEM = {
  0xff, 0xff, 0xff, 0xff, 0xff, 0xf8, 0x07, 0xff, 0xff, 0xe0, 0x01, 0xff, 0xff, 0x80, 0xe0, 0x7f, 
  0xff, 0x87, 0xfc, 0x3f, 0xef, 0x9f, 0xfe, 0x1f, 0xc7, 0xff, 0xff, 0x0f, 0xe3, 0xff, 0xff, 0x8f, 
  0xf1, 0xff, 0xff, 0xc7, 0xf8, 0xff, 0xff, 0xc7, 0xf8, 0x7f, 0xff, 0xe7, 0xf8, 0x3f, 0xff, 0xe3, 
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  0xff, 0xff, 0xff, 0x1f, 0xff, 0xff, 0xff, 0xcf, 0xff, 0xff, 0xff, 0xdf, 0xff, 0xff, 0xff, 0xff
};

// ==========================================
// SCREEN DRAWING FUNCTIONS
// ==========================================

void drawBootScreen() {
  tft.fillScreen(TFT_BLACK); 
  
  if (connection_status == false) {
    tft.setTextColor(TFT_RED); 
    tft.setTextSize(3);             
    tft.setCursor(90, 60);         
    tft.print("Connection Status");

    tft.fillRect(100, 120, 280, 80, TFT_RED);
    tft.setTextColor(TFT_BLACK); 
    tft.setTextSize(3);              
    tft.setCursor(110, 145);          
    tft.print("NOT ESTABLISHED");
  } else {
    tft.setTextColor(TFT_GREEN); 
    tft.setTextSize(3);             
    tft.setCursor(80, 60);         
    tft.print("Connection Status");

    tft.fillRect(100, 120, 280, 80, TFT_GREEN);
    tft.setTextColor(TFT_WHITE); 
    tft.setTextSize(3);              
    tft.setCursor(140, 145);          
    tft.print("ESTABLISHED");
    delay(1000);
    drawMainScreen();
  }
}

void drawMainScreen() {
  tft.fillScreen(TFT_BLACK); 

  // --- ΑΡΙΣΤΕΡΟ ΚΟΥΤΙ: PC SYSTEM (Λευκό) ---
  tft.drawRect(0, 0, 238, 320, TFT_WHITE); 
  tft.fillRect(2, 2, 234, 316, TFT_WHITE);

  // Volume UI
  tft.drawBitmap(20, 20, volume_logo, 32, 32, TFT_BLACK);
  tft.drawRect(70, 31, 140, 10, TFT_BLACK); 

  // Mic UI (Defaults to UNMUTED)
  tft.drawBitmap(25, 120, microphone_unmuted, 32, 32, TFT_BLACK);
  tft.fillRect(20, 160, 50, 30, TFT_WHITE); 
  tft.setTextSize(3);
  tft.setTextColor(TFT_GREEN); 
  tft.setCursor(22, 165);
  tft.print("ON");

  // Cam UI
  tft.drawBitmap(145, 120, cam_logo, 32, 32, TFT_BLACK);
  tft.fillRect(140, 160, 60, 30, TFT_WHITE);
  tft.setTextColor(TFT_RED);
  tft.setCursor(140, 165);
  tft.print("OFF");

  // --- ΔΕΞΙ ΚΟΥΤΙ ΠΑΝΩ: MULTIMEDIA (Μαύρο) ---
  tft.drawRect(238, 0, 242, 160, TFT_WHITE); 
  tft.fillRect(240, 2, 238, 156, TFT_BLACK);

  // Spotify UI
  tft.drawBitmap(250, 20, spotify_logo, 32, 32, TFT_GREEN);
  tft.drawRect(250, 110, 210, 10, TFT_WHITE);

  // Spotify Timestamps
  tft.setTextSize(2);
  tft.setTextColor(TFT_WHITE);
  tft.setCursor(250, 130);
  tft.print("0:00");
  tft.setCursor(410, 130);
  tft.print("0:00");

  // --- ΔΕΞΙ ΚΟΥΤΙ ΚΑΤΩ: DISCORD AREA (Blurple) ---
  tft.drawRect(238, 160, 242, 160, TFT_WHITE); 
  tft.fillRect(240, 162, 238, 156, BLURPLE);

  // Main Discord Identity Logo 
  tft.drawBitmap(260, 205, discord_logo, 64, 64, TFT_WHITE);

  // Status Logo (Undeafened by default)
  tft.drawBitmap(380, 220, undeafened, 32, 32, TFT_WHITE); 
}

// ==========================================
// SETUP
// ==========================================
void setup() {
  Serial.begin(115200);
  delay(1000); 
  Serial.println("--- STARTING BOOT ---");

  // --- ΠΡΟΣΘΗΚΗ: ΑΡΧΙΚΟΠΟΙΗΣΗ ΤΟΥ IO EXPANDER ---
  if (!mcp.begin_I2C()) {
    Serial.println("❌ ΣΦΑΛΜΑ: Το MCP23017 δεν βρέθηκε! (I2C Error)");
  } else {
    Serial.println("✅ MCP23017 Initialized!");
    // Ενεργοποιούμε το Pull-Up για το κουμπί 1
    mcp.pinMode(BTN_SPOT_TOGGLE, INPUT_PULLUP);
    mcp.pinMode(BTN_NEXT, INPUT_PULLUP);
    mcp.pinMode(BTN_PREV, INPUT_PULLUP);
  }

  tft.begin();
  tft.setRotation(1); 
  
  tft.fillScreen(TFT_WHITE); 
  delay(200);
  tft.fillScreen(TFT_BLACK); 
  delay(200);
  
  Serial.println("Display Initialized");
  drawBootScreen();
}

// ==========================================
// MAIN LOOP
// ==========================================
void loop() {

  // --- ΠΡΟΣΘΗΚΗ: ΔΙΑΒΑΣΜΑ ΚΟΥΜΠΙΩΝ ΑΠΟ ΤΟ MCP23017 ---
  bool currentSpotToggleState = mcp.digitalRead(BTN_SPOT_TOGGLE);
  
  // Αν το κουμπί μόλις πατήθηκε (από HIGH πήγε LOW)
  if (lastSpotToggleState == HIGH && currentSpotToggleState == LOW) {
    // Στέλνουμε το σήμα στη Python για να αλλάξει το Spotify
    Serial.println("<BTN:SPOT_TOGGLE>");
    delay(50); // Μικρή καθυστέρηση (Debounce) για να μην στείλει την εντολή 10 φορές
  }
  lastSpotToggleState = currentSpotToggleState;

  // --- ΔΙΑΒΑΣΜΑ ΚΟΥΜΠΙΟΥ: NEXT ---
  bool currentNextState = mcp.digitalRead(BTN_NEXT);
  if (lastNextState == HIGH && currentNextState == LOW) {
    // Εδώ βάζεις το δικό σου function ή το Serial.println
    Serial.println("<BTN:NEXT>"); 
    delay(50); // Debounce
  }
  lastNextState = currentNextState;


  // --- ΔΙΑΒΑΣΜΑ ΚΟΥΜΠΙΟΥ: PREVIOUS ---
  bool currentPrevState = mcp.digitalRead(BTN_PREV);
  if (lastPrevState == HIGH && currentPrevState == LOW) {
    // Εδώ βάζεις το δικό σου function ή το Serial.println
    Serial.println("<BTN:PREV>"); 
    delay(50); // Debounce
  }
  lastPrevState = currentPrevState;


  // --- TEXT ANIMATION (MARQUEE) ---
  if (connection_status == true && currentSong.length() > 11) {
    
    int waitTime = 300; 
    if (scrollIndex == 0) {
      waitTime = 1500; 
    }

    if (millis() - lastScrollTime > waitTime) {
      lastScrollTime = millis(); 
      
      tft.fillRect(250, 70, 210, 30, TFT_BLACK); 
      
      String visibleText = currentSong.substring(scrollIndex, scrollIndex + 11);
      
      tft.setTextSize(3);
      tft.setTextColor(TFT_WHITE);
      tft.setCursor(250, 70);
      tft.print(visibleText);

      scrollIndex++;
      
      if (scrollIndex > currentSong.length() - 11) {
        scrollIndex = 0; 
      }
    }
  }
  
  // --- SERIAL COMMUNICATION ---
  if (Serial.available() > 0) {
    
    String incomingMessage = Serial.readStringUntil('\n');
    incomingMessage.trim();
    
    // Unlock Screen
    if (connection_status == false) {
      if (incomingMessage == "<PC_OK>") {
        connection_status = true;      
        drawBootScreen();         
      }
    }
    
    delay(50); 

    // Spotify Progress Bar % Listener
    if (incomingMessage.startsWith("<SPOT_PERC:")) {
        String valueText = incomingMessage.substring(11, incomingMessage.indexOf('>'));
        int progress = valueText.toInt(); 
        int barWidth = map(progress, 0, 100, 0, 206); 

        tft.fillRect(252, 112, barWidth, 6, TFT_WHITE); 
        tft.fillRect(252 + barWidth, 112, 206 - barWidth, 6, TFT_BLACK); 
    }
    
    // Spotify Song Name Listener
    else if (incomingMessage.startsWith("<SPOT_INFO:")) {
      String newSong = incomingMessage.substring(11, incomingMessage.indexOf('>'));
      
      if (newSong.length() > 11) {
        newSong += "   ";
      }

      if (currentSong != newSong) {
        currentSong = newSong;
        scrollIndex = 0; 

        tft.fillRect(250, 70, 210, 30, TFT_BLACK); 
        tft.setTextSize(3);
        tft.setTextColor(TFT_WHITE);
        tft.setCursor(250, 70);

        if (currentSong.length() <= 11) {
          tft.print(currentSong); 
        }
      }
    }

    // Current Time Listener
    else if (incomingMessage.startsWith("<SPOT_POS:")) {
      String curTime = incomingMessage.substring(10, incomingMessage.indexOf('>'));
      
      tft.fillRect(250, 130, 60, 20, TFT_BLACK); 
      tft.setTextSize(2);
      tft.setTextColor(TFT_WHITE);
      tft.setCursor(250, 130);
      tft.print(curTime);
    }

    // Total Time Listener
    else if (incomingMessage.startsWith("<SPOT_DUR:")) {
      String maxTime = incomingMessage.substring(10, incomingMessage.indexOf('>'));
      
      tft.fillRect(410, 130, 60, 20, TFT_BLACK); 
      tft.setTextSize(2);
      tft.setTextColor(TFT_WHITE);
      tft.setCursor(410, 130); 
      tft.print(maxTime);
    }
    
    // PC Volume Listener
    else if (incomingMessage.startsWith("<VOL:")) {
        String valueText = incomingMessage.substring(5, incomingMessage.indexOf('>'));
        int volume = valueText.toInt(); 
        int barWidth = map(volume, 0, 100, 0, 136);

        tft.fillRect(72, 33, barWidth, 6, TFT_BLACK); 
        tft.fillRect(72 + barWidth, 33, 136 - barWidth, 6, TFT_WHITE); 
    } 
    
    // Mic Status Listener
    else if (incomingMessage.startsWith("<MIC:")) {
      String status = incomingMessage.substring(5, incomingMessage.indexOf('>'));
      
      tft.fillRect(20, 160, 60, 30, TFT_WHITE); 
      tft.fillRect(25, 120, 32, 32, TFT_WHITE); 

      tft.setTextSize(3);
      tft.setCursor(22, 165);

      if (status == "ON") {
        tft.drawBitmap(25, 120, microphone_unmuted, 32, 32, TFT_BLACK);
        tft.setTextColor(TFT_GREEN);
        tft.print("ON");
      } else {
        tft.drawBitmap(25, 120, microphone_muted, 32, 32, TFT_RED);
        tft.setTextColor(TFT_RED);
        tft.print("OFF");
      }
    }

    // Cam Status Listener
    else if (incomingMessage.startsWith("<CAM:")) {
      String status = incomingMessage.substring(5, incomingMessage.indexOf('>'));
      
      tft.fillRect(140, 160, 60, 30, TFT_WHITE); 
      tft.setTextSize(3);
      tft.setCursor(140, 165);

      if (status == "ON") {
        tft.setTextColor(TFT_GREEN);
        tft.print("ON");
      } else {
        tft.setTextColor(TFT_RED);
        tft.print("OFF");
      }
    }
    
    // Discord Status Listener
    else if (incomingMessage.startsWith("<DISC:")) {
      String status = incomingMessage.substring(6, incomingMessage.indexOf('>'));
      
      tft.fillRect(380, 220, 32, 32, BLURPLE); 

      if (status == "DEAF") {
        tft.drawBitmap(380, 220, deafened, 32, 32, TFT_RED);
      } else {
        tft.drawBitmap(380, 220, undeafened, 32, 32, TFT_WHITE);
      }
    }
  }
}